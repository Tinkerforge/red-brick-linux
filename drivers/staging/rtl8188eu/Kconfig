## drivers/staging/rtl8188eu/Kconfig
```kconfig
config R8188EU
	tristate "Realtek RTL8188EU Wireless LAN NIC driver"
	depends on WLAN && USB && CFG80211
	depends on m
	select WIRELESS_EXT
	select WEXT_PRIV
	---help---
	This option adds the Realtek RTL8188EU USB device such as TP-Link TL-WN725N.
	If built as a module, it will be called r8188eu.

if R8188EU

	config 88EU_AP_MODE
		bool "Realtek RTL8188EU AP mode"
		default y
		---help---
		This option enables Access Point mode. Unless you know that your system
		will never be used as an AP, or the target system has limited memory,
		"Y" should be selected.

	if 88EU_AP_MODE

		config 88EU_NEW_WEXT_PRIVATE_IOCTL_INTERFACE
			bool "Use new WEXT private IOCTL interface for this driver"
			default n
			---help---
			In kernel versions 4.12 and lower WEXT private IOCTL calls were invoked
			through netdevice's ndo_do_ioctl() interface. In newer kernels private
			handler table is used for private IOCTL calls.
			Enable this option if the driver is intended to be used in a kernel which
			doesn't use netdevice's ndo_do_ioctl() interface for private IOCTLs and
			AP mode is desired.

	endif

endif
```
